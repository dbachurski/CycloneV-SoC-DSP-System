## sw/meta-agh/conf/distro/agh-poky-tiny.conf
```bitbake
require conf/distro/poky-tiny.conf
require include/agh.inc

DISTRO = "agh-poky-tiny"
DISTRO_NAME = "AGH SoC Linux (agh-poky-tiny)"
```

## sw/meta-agh/conf/distro/agh-poky.conf
```bitbake
require conf/distro/poky.conf
require include/agh.inc

DISTRO = "agh-poky"
DISTRO_NAME = "AGH SoC Linux (agh-poky)"
```

## sw/meta-agh/conf/layer.conf
```bitbake
BBPATH .= ":${LAYERDIR}"
BBFILES:append = " ${LAYERDIR}/recipes*/*/*.bb ${LAYERDIR}/recipes*/*/*.bbappend "
BBFILE_COLLECTIONS:append = " meta-agh "
BBFILE_PATTERN_meta-agh := "^${LAYERDIR}/"
BBFILES_PRIORITY_meta-agh = "7"
LAYERSERIES_COMPAT_meta-agh = "master nanbield"
BBDEBUG = "yes"
```
